// This file was generated from a template. Edit it to match your keyboard.
// See https://zmk.dev/docs/development/hardware-integration/new-shield for more
// instructions.

#include <dt-bindings/zmk/matrix_transform.h>

#include "tickler41-layouts.dtsi"

/ {
    chosen {
        zmk,physical-layout = &default_layout;
    };

    kscan: kscan {
        compatible = "zmk,kscan-gpio-direct";
        wakeup-source;

        input-gpios
            = <&gpio0 20 (GPIO_ACTIVE_LOW | GPIO_PULL_UP)>
            , <&gpio1 0 (GPIO_ACTIVE_LOW | GPIO_PULL_UP)>
            , <&gpio1 15 (GPIO_ACTIVE_LOW | GPIO_PULL_UP)>
            , <&gpio1 11 (GPIO_ACTIVE_LOW | GPIO_PULL_UP)>
            ;
    };

    default_transform: default_transform {
        // See https://zmk.dev/docs/development/hardware-integration/new-shield#matrix-transform
        // for how to configure this
        compatible = "zmk,matrix-transform";
        columns = <4>;
        rows = <1>;

        map = <
            RC(0, 0) RC(0, 1) RC(0, 2) RC(0, 3)
        >;
    };
};
